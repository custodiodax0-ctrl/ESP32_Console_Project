#include "dashboard.h"
#include "display.h"
#include "clock.h"
#include "battery.h"
#include "wifi_mgr.h"
#include "bluetooth_mgr.h"
#include "buttons.h"
#include "sound.h"
#include "state.h"

// ── Lopaka Generated Bitmaps ──────────────────────────────────────────────────
static const unsigned char PROGMEM image_Battery_indicator_bits[] = {
    0x7f,0xfc,0x80,0x02,0xb6,0xda,0xb6,0xda,0xb6,0xda,0x80,0x02,0x7f,0xfc
};

static const unsigned char PROGMEM image_BT_indicator_bits[] = {
    0x98,0x54,0x36,0x1c,0x36,0x54,0x98
};

static const unsigned char PROGMEM image_colon_bits[] = {
    0x60,0xf0,0xf0,0x60,0x00,0x00,0x00,0x00,0x00,0x00,0x00,0x00,0x00,0x00,0x00,0x00,0x00,0x60,0xf0,0xf0,0x60
};

static const unsigned char PROGMEM image_current_days_bits[] = {
    0xfa,0x2f,0x80,0x22,0x28,0x00,0x22,0x2e,0x00,0x22,0x28,0x00,0x23,0xef,0x80
};

static const unsigned char PROGMEM image_Date_day_bits[] = {
    0xfb,0x80,0x88,0x80,0x88,0x80,0x88,0x80,0xfb,0xe0
};

static const unsigned char PROGMEM image_Date_Month_bits[] = {
    0x0a,0x28,0x80,0x0a,0x2c,0x80,0x0a,0x2a,0x80,0x8a,0x29,0x80,0xfb,0xe8,0x80
};

static const unsigned char PROGMEM image_Humidity_indicator_bits[] = {
    0x63,0x30,0x00,0x94,0xb3,0x00,0x94,0x84,0x80,0x23,0x84,0x00,0x40,0x84,0x00,0x80,0x84,0x80,0xf7,0x03,0x00
};

static const unsigned char PROGMEM image_Loc_province_bits[] = {
    0xf2,0x28,0x00,0x8a,0x28,0x00,0xf2,0x28,0x00,0x8a,0x28,0x00,0xf1,0xcf,0x80
};

static const unsigned char PROGMEM image_Nation_bits[] = {
    0xf2,0x2f,0x80,0x8a,0x22,0x00,0xf3,0xe2,0x00,0x82,0x22,0x00,0x82,0x2f,0x80
};

static const unsigned char PROGMEM image_Rain_indicator_bits[] = {
    0x63,0x00,0x00,0x94,0x98,0x80,0x14,0x99,0x00,0x23,0x82,0x00,0x10,0x84,0x00,0x90,0x89,0x80,0x67,0x11,0x80
};

static const unsigned char PROGMEM image_Temp_bitmap_bits[] = {
    0x18,0x90,0x25,0x20,0x24,0x90,0x24,0x48,0x24,0x48,0x24,0x90,0x25,0x20,0x24,0x40,
    0x42,0x08,0x99,0x2a,0xbd,0x1c,0xbd,0x77,0x99,0x1c,0x42,0x2a,0x3c,0x08
};

static const unsigned char PROGMEM image_Wifi_indicator_bits[] = {
    0x3c,0x42,0x99,0x24,0x42,0x18,0x24
};

// Merged Border Bitmap (124x51)
static const unsigned char PROGMEM image_border_pixels[] = {
    0xff, 0xff, 0xff, 0xff, 0xff, 0xff, 0xff, 0xff, 0xff, 0xff, 0xff, 0xff, 0xff, 0xff, 0xff, 0xf0,
    0x80, 0x00, 0x00, 0x00, 0x00, 0x00, 0x00, 0x00, 0x00, 0x01, 0x00, 0x00, 0x00, 0x00, 0x00, 0x10,
    0x80, 0x00, 0x00, 0x00, 0x00, 0x00, 0x00, 0x00, 0x00, 0x01, 0x00, 0x00, 0x00, 0x00, 0x00, 0x10,
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    0xff, 0xff, 0xff, 0xff, 0xff, 0xff, 0xff, 0xff, 0xff, 0xff, 0xff, 0xff, 0xff, 0xff, 0xff, 0xf0
};

// Weather condition bitmaps (16x15)
static const unsigned char PROGMEM image_weather_sunny[] = {
    0x00, 0x00, 0x01, 0x80, 0x00, 0x00, 0x10, 0x08, 0x03, 0xc0, 0x04, 0x20, 0x08, 0x10, 0x68, 0x16,
    0x08, 0x10, 0x04, 0x20, 0x03, 0xc0, 0x10, 0x08, 0x00, 0x00, 0x01, 0x80, 0x00, 0x00
};

static const unsigned char PROGMEM image_weather_cloudy[] = {
    0x00, 0x00, 0x00, 0x00, 0x03, 0xc0, 0x04, 0x20, 0x08, 0x10, 0x30, 0x0c, 0x40, 0x02, 0x80, 0x01,
    0x80, 0x01, 0x40, 0x02, 0x3f, 0xfc, 0x00, 0x00, 0x00, 0x00, 0x00, 0x00, 0x00, 0x00
};

static const unsigned char PROGMEM image_weather_rainy[] = {
    0x00, 0x00, 0x03, 0xc0, 0x04, 0x20, 0x08, 0x10, 0x30, 0x0c, 0x40, 0x02, 0x80, 0x01, 0x7f, 0xfe,
    0x00, 0x00, 0x21, 0x08, 0x10, 0x84, 0x21, 0x08, 0x10, 0x84, 0x00, 0x00, 0x00, 0x00
};

static const unsigned char PROGMEM image_weather_thunder[] = {
    0x00, 0x00, 0x03, 0xc0, 0x04, 0x20, 0x30, 0x1c, 0x40, 0x02, 0x80, 0x01, 0x7f, 0xfe, 0x01, 0x00,
    0x02, 0x00, 0x07, 0x80, 0x01, 0x00, 0x02, 0x00, 0x04, 0x00, 0x00, 0x00, 0x00, 0x00
};

// 7-segment 15x29 bitmaps for digits 0-9 matching Lopaka's precise segment geometry
static const unsigned char PROGMEM image_segment_4_bits[] = {
    0x20,0x60,0xe0,0xe0,0xe0,0xe0,0xe0,0xe0,0xe0,0xe0,0xe0,0x60,0x20,0x00,0x20,0x60,0xe0,0xe0,0xe0,0xe0,0xe0,0xe0,0xe0,0xe0,0xe0,0x60,0x20
};

static const unsigned char PROGMEM image_digits_15x29[10][58] = {
    { 0x7f,0xfc,0xbf,0xfa,0xdf,0xf6,0xe0,0x0e,0xe0,0x0e,0xe0,0x0e,0xe0,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0x7f,0xfc },
    { 0 },
    { 0x7f,0xfc,0x3f,0xfa,0x1f,0xf6,0x00,0x0e,0x00,0x0e,0x00,0x0e,0x00,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0x7f,0xfc },
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    { 0x7f,0xfc,0xbf,0xfa,0xdf,0xf6,0xe0,0x0e,0xe0,0x0e,0xe0,0x0e,0xe0,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0x7f,0xfc }
};

static void drawDigit(int x, int y, int digit) {
    if (digit == 1) {
        // Draw 3x27 digit 1 bitmap centered in segment position
        display.drawBitmap(x + 6, y + 1, image_segment_4_bits, 3, 27, 1);
    } else if (digit >= 0 && digit <= 9) {
        // Draw 15x29 segment digit bitmap
        display.drawBitmap(x, y, image_digits_15x29[digit], 15, 29, 1);
    }
}

void initDashboard() {
    // Dashboard init
}

void drawDashboard_Design(void) {
    display.clearDisplay();

    DateTime now = getCurrentTime();
    int hr = now.hour();
    int min = now.minute();

    int d1 = (hr / 10) % 10;
    int d2 = hr % 10;
    int d3 = (min / 10) % 10;
    int d4 = min % 10;

    // Battery indicator
    if (getBatteryPercent() > 20) {
        display.drawBitmap(110, 2, image_Battery_indicator_bits, 15, 7, 1);
    } else {
        if ((millis() / 500) % 2 == 0) {
            display.drawBitmap(110, 2, image_Battery_indicator_bits, 15, 7, 1);
        }
    }

    // BT indicator
    if (isBluetoothEnabled()) {
        display.drawBitmap(3, 2, image_BT_indicator_bits, 7, 7, 1);
    }

    // Wifi indicator
    if (isWifiConnected()) {
        display.drawBitmap(14, 2, image_Wifi_indicator_bits, 8, 7, 1);
    }

    // Location & Nation
    display.drawBitmap(84, 15, image_Loc_province_bits, 17, 5, 1);
    display.drawBitmap(105, 15, image_Nation_bits, 17, 5, 1);

    // Weather condition bitmap (16x15)
    const char* cond = getWeatherConditionText();
    if (strstr(cond, "Rain") != NULL) {
        display.drawBitmap(84, 26, image_weather_rainy, 16, 15, 1);
    } else if (strstr(cond, "Storm") != NULL || strstr(cond, "Thunder") != NULL) {
        display.drawBitmap(84, 26, image_weather_thunder, 16, 15, 1);
    } else if (strstr(cond, "Cloud") != NULL) {
        display.drawBitmap(84, 26, image_weather_cloudy, 16, 15, 1);
    } else {
        display.drawBitmap(84, 26, image_weather_sunny, 16, 15, 1);
    }

    // Indicators
    display.drawBitmap(103, 31, image_Rain_indicator_bits, 17, 7, 1);
    display.drawBitmap(84, 43, image_Temp_bitmap_bits, 16, 15, 1);
    display.drawBitmap(103, 47, image_Humidity_indicator_bits, 17, 7, 1);

    // Dynamic 7-Segment Digits
    drawDigit(6, 27, d1);
    drawDigit(23, 27, d2);
    drawDigit(46, 27, d3);
    drawDigit(63, 27, d4);

    // Colon (blinks every second)
    if ((millis() / 500) % 2 == 0) {
        display.drawBitmap(40, 31, image_colon_bits, 4, 21, 1);
    }

    // Days & Date Bitmaps
    display.drawBitmap(59, 17, image_current_days_bits, 17, 5, 1);
    display.drawBitmap(8, 17, image_Date_Month_bits, 17, 5, 1);
    display.drawBitmap(37, 17, image_Date_day_bits, 11, 5, 1);

    // Single Merged Border Frame (124x51 at x=2, y=11)
    display.drawBitmap(2, 11, image_border_pixels, 124, 51, 1);

    display.display();
}

void updateDashboard() {
    drawDashboard_Design();

    if (isButtonPressed(BTN_A) || isButtonPressed(BTN_SELECT)) {
        playClickSound();
        setState(APP_MAIN_MENU);
    }
}
